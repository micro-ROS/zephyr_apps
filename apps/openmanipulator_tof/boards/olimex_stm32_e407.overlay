/*
 * Copyright (c) 2019, Nordic Semiconductor ASA
 *
 * SPDX-License-Identifier: Apache-2.0
 */

&i2c1 {
	status = "okay";
	clock-frequency = <I2C_BITRATE_FAST>;

	vl53l1x@29 {
		compatible = "st,vl53l1x";
		reg = <0x29>;
		label = "VL53L1X";
	};
};